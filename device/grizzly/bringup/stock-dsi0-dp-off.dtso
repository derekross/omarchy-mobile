// SPDX-License-Identifier: MIT
/dts-v1/;
/plugin/;

/ {
    // Add a fragment to the D1 B0 board overlay.
    fragment@0 {
        target-path = "/";
        __overlay__ {
            fragment@grizzly-dp-off {
                target-path = "/sswrp_dpu@f400000/dp-encoder";
                __overlay__ {
                    status = "disabled";
                };
            };
        };
    };
};
