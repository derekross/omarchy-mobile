// SPDX-License-Identifier: GPL-2.0-only
/*
 * Bring-up overlay, never default (BRINGUP-M4, M4.2): load Google's ModelGauge
 * m5 model "atl-a1-1k" into the Pixel 8a's fuel gauge. The node is picked by
 * the pack's ID, byte 0x17 of its EEPROM: 0 default-a1-0k (Google's fallback
 * for an unknown pack), 1 atl-a1-1k, 2 cos-a1-2k, 4 lwn-a1-4k. The 8a this was
 * written on reads 1. Generated by tools/gen-gauge-overlay.py from Google's
 * public, GPL-2.0-only dts/zuma-akita-battery-data.dtsi (kernel/devices/google/
 * akita, tag android-16.0.0_r0.10,
 * https://android.googlesource.com/kernel/devices/google/akita/+/refs/tags/android-16.0.0_r0.10/dts/zuma-akita-battery-data.dtsi):
 * maxim,fg-model = that node's 48 u16 table words, maxim,fg-params = its
 * parameter words in the order of struct max77759_fg_params (DesignCap 0x08c3,
 * 4486 mAh at 2 mAh per unit, what the stock gauge reports). The driver loads
 * it only while the gauge reports power-on reset (Status bit 1), then clears
 * that bit. The table and the parameters are Copyright 2022 Google LLC, from
 * that file.
 */
/dts-v1/;
/plugin/;

&hsi2c_11 {
	fuel-gauge@36 {
	maxim,fg-model = /bits/ 16 <
			0xa4a0 0xb520 0xb8b0 0xbbf0 0xbd30 0xbdf0 0xbef0 0xc000
			0xc1c0 0xc420 0xc820 0xcbb0 0xcef0 0xd270 0xd5a0 0xdd30
			0x0090 0x0d30 0x0a00 0x0620 0x3c00 0x1c00 0x0960 0x0ce0
			0x0bf0 0x05f0 0x07d0 0x07f0 0x05d0 0x05b0 0x06f0 0x06f0
			0x0200 0x0200 0x0200 0x0200 0x0200 0x0200 0x0200 0x0200
			0x0200 0x0200 0x0200 0x0200 0x0200 0x0200 0x0200 0x0200
	>;
	maxim,fg-params = /bits/ 16 <
			0xf060 0x1438 0x260e 0x4217 0x0090 0x5f00 0x08c3 0x08c3
			0x3200 0x0230 0x08c3 0xa561 0x2080 0x0e80 0x0580 0x0400
			0x09a0 0x1002 0x0580 0xed51 0x1eba 0x0014 0x6070 0x1900
			0x2241 0x0613 0x2d00 0x0400
	>;
	};
};
