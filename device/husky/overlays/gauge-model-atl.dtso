// SPDX-License-Identifier: GPL-2.0-only
/*
 * Bring-up overlay, never default (BATTERY-NOTES.md M4c and 5.6): load Google's
 * ModelGauge m5 model "atl-a1-1k" into the husky fuel gauge. The node is picked by the
 * pack's ID, byte 0x17 of its EEPROM: 0 default-a1-0k (what Google falls back to for
 * an unknown pack), 1 atl-a1-1k, 2 cos-a1-2k. Generated by tools/gen-gauge-overlay.py
 * from Google's public, GPL-2.0-only dts/zuma-husky-battery-data.dtsi (kernel/devices/
 * google/shusky, branch android-gs-shusky-6.1-android16,
 * https://android.googlesource.com/kernel/devices/google/shusky/+/refs/heads/android-gs-shusky-6.1-android16/dts/zuma-husky-battery-data.dtsi):
 * maxim,fg-model = that node's 48 u16 table words, maxim,fg-params = its parameter
 * words in the order of struct max77759_fg_params. The driver loads it only while the
 * gauge reports power-on reset (Status bit 1), then clears that bit.
 * The table and the parameters are Copyright 2022 Google LLC, from that file.
 */
/dts-v1/;
/plugin/;

&hsi2c_11 {
	fuel-gauge@36 {
	maxim,fg-model = /bits/ 16 <
			0xa500 0xb790 0xb920 0xba60 0xbc70 0xbe00 0xbea0 0xc0b0
			0xc270 0xc5d0 0xc930 0xcc40 0xcf40 0xd340 0xd6b0 0xde40
			0x01e0 0x0b00 0x0d00 0x1310 0x1710 0x1410 0x0f00 0x0b00
			0x0910 0x0810 0x07b0 0x07e0 0x05b0 0x07f0 0x04f0 0x04f0
			0x0200 0x0200 0x0200 0x0200 0x0200 0x0200 0x0200 0x0200
			0x0200 0x0200 0x0200 0x0200 0x0200 0x0200 0x0200 0x0200
	>;
	maxim,fg-params = /bits/ 16 <
			0xf060 0x1439 0x260e 0x4217 0x0090 0x5f00 0x09cf 0x09cf
			0x3200 0x0273 0x09cf 0xa561 0x2400 0x0f80 0x0580 0x0480
			0x03b0 0x1402 0x0630 0xed51 0x1eba 0x0014 0x6070 0x1900
			0x2241 0x0613 0x2d00
	>;
	};
};
