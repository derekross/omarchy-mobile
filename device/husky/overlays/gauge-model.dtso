// SPDX-License-Identifier: GPL-2.0-only
/*
 * Bring-up overlay, never default (BATTERY-NOTES.md M4c and 5.6): load Google's
 * ModelGauge m5 model "default-a1-0k" into the husky fuel gauge. The node is picked by the
 * pack's ID, byte 0x17 of its EEPROM: 0 default-a1-0k (what Google falls back to for
 * an unknown pack), 1 atl-a1-1k, 2 cos-a1-2k. Generated by tools/gen-gauge-overlay.py
 * from Google's public, GPL-2.0-only dts/zuma-husky-battery-data.dtsi (kernel/devices/
 * google/shusky, branch android-gs-shusky-6.1-android16,
 * https://android.googlesource.com/kernel/devices/google/shusky/+/refs/heads/android-gs-shusky-6.1-android16/dts/zuma-husky-battery-data.dtsi):
 * maxim,fg-model = that node's 48 u16 table words, maxim,fg-params = its parameter
 * words in the order of struct max77759_fg_params. The driver loads it only while the
 * gauge reports power-on reset (Status bit 1), then clears that bit.
 */
/dts-v1/;
/plugin/;

&hsi2c_11 {
	fuel-gauge@36 {
	maxim,fg-model = /bits/ 16 <
			0x9760 0xa510 0xb100 0xb600 0xb7a0 0xb900 0xba70 0xbc70
			0xbde0 0xbfc0 0xc250 0xc510 0xc990 0xcea0 0xd040 0xd750
			0x0060 0x0120 0x0200 0x0710 0x0e80 0x0df0 0x1430 0x1bd0
			0x1520 0x0d70 0x0950 0x08e0 0x0800 0x0780 0x06b0 0x01e0
			0x0100 0x0100 0x0100 0x0100 0x0100 0x0100 0x0100 0x0100
			0x0100 0x0100 0x0100 0x0100 0x0100 0x0100 0x0100 0x0100
	>;
	maxim,fg-params = /bits/ 16 <
			0xf060 0x2038 0x260e 0x4217 0x0090 0x5f00 0x0994 0x0994
			0x0c80 0x0099 0x0994 0xa561 0x1100 0x0800 0x0301 0x0302
			0x0700 0x223e 0x0310 0xed51 0x1eba 0x0014 0x3870 0x0000
			0x2241 0xc623 0x2d00
	>;
	};
};
