// SPDX-License-Identifier: GPL-2.0-only
/*
 * Bring-up probe, never default: the real init, with lockups and RCU stalls
 * turned into a panic and a reset, and the init's omamobile.deadman marker
 * crashing at a time that encodes how far it got (initramfs/init). zuma's
 * ABL clears ramoops, so the timing is the log. Needs a kernel with, on
 * top of husky's kernel.config: CONFIG_DETECT_HUNG_TASK=y (defconfig turns
 * it off), CONFIG_WQ_WATCHDOG=y, CONFIG_PANIC_ON_OOPS=y and
 * CONFIG_DYNAMIC_DEBUG=y for the dyndbg line below.
 */
/dts-v1/;
/plugin/;

&{/chosen} {
	bootargs = "console=tty0 fbcon=font:TER16x32 reboot=warm panic=5 clk_ignore_unused pd_ignore_unused rdinit=/init printk.devkmsg=on ignore_loglevel nmi_watchdog=panic softlockup_panic=1 hung_task_panic=0 hung_task_timeout_secs=20 sysctl.kernel.panic_on_rcu_stall=1 rcupdate.rcu_cpu_stall_timeout=10 dyndbg=\"file drivers/usb/dwc3/* +p; file drivers/usb/gadget/udc/* +p\" omamobile.deadman=20 omamobile.deadman_step=7 omamobile.deadman_why=11210000.usb";
};
