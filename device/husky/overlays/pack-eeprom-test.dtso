// SPDX-License-Identifier: GPL-2.0-only
/*
 * Bring-up probe, never default (BATTERY-NOTES.md, the pack ID): switches on
 * USI9 and hsi2c_9, the bus of the battery pack's EEPROM, whose byte 0x17 is
 * the battery ID that picks the fuel gauge model. CMU_PERIC1 and its sysreg are
 * on already when battery-i2c-test is loaded; repeating them is harmless. The
 * EEPROM node itself is in the board file (read-only). Needs the kernel with
 * the USI9 clock path.
 */
/dts-v1/;
/plugin/;

&cmu_peric1 {
	status = "okay";
};

&sysreg_peric1 {
	status = "okay";
};

&usi9 {
	status = "okay";
};

&hsi2c_9 {
	status = "okay";
};
