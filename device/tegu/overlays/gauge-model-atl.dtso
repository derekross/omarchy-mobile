// SPDX-License-Identifier: GPL-2.0-only
/*
 * Bring-up overlay, never default: load Google's ModelGauge m5 model "atl-1k"
 * (battery ID 1, model version 1) into the Pixel 9a's MAX77779 fuel gauge after
 * a power-on reset. Google's driver picks the node by the pack's ID, byte 0x17
 * of its EEPROM: 1 atl-1k, 4 lwn-4k. Generated by gen-gauge-overlay-tegu.py from
 * Google's public, GPL-2.0-only dts/zuma-tegu-battery-data.dtsi
 * (kernel/devices/google/tegu, branch android-gs-tegu-6.1-android16,
 * https://android.googlesource.com/kernel/devices/google/tegu/+/refs/heads/android-gs-tegu-6.1-android16/dts/zuma-tegu-battery-data.dtsi):
 * maxim,fg-model = that node's 32 u16 table words, maxim,fg-params = its 22
 * parameter words in the order of Google's struct max77779_custom_parameters.
 * nFullSOCThr and nMiscCfg as Google's driver writes them at a load, from
 * max77779,fg-aafv row 0 (200 0 95 0xff): 0x5f00 -> 0x5f00,
 * 0x3870 -> 0xf870 (max77779_model_apply_aaf_fullsoc()).
 * The driver loads it only while the gauge reports power-on reset (Status
 * bit 1), then clears that bit. The table and the parameters are Copyright
 * 2024 Google LLC, from that file.
 *
 * Which pack: our device tree doesn't describe the pack's EEPROM, so read the
 * size while stock's model is still in the gauge, before the first load of
 * an overlay: charge_full_design reads 5110000 on an ATL pack and 5120000 on
 * an LWN pack. A wrong model stays in the gauge until its next power-on
 * reset, which takes a flat pack, and until then the charge follows the
 * other pack's curve. After a load the gauge counts cycles from the reset:
 * cycle_count, and the battery panel's charge cycles, read 0 for an old
 * pack: Google's driver keeps the pack's own count in that EEPROM.
 */
/dts-v1/;
/plugin/;

&fuel_gauge {
	maxim,fg-model = /bits/ 16 <
		0x9620 0xad30 0xb8a0 0xb8e0 0xb920 0xbb30 0xbd70 0xbe40
		0xbf60 0xc020 0xc260 0xc6c0 0xca60 0xd150 0xd9a0 0xdf10
		0x0080 0x0170 0x3320 0x32e0 0x0e00 0x0f20 0x1540 0x0e10
		0x1b70 0x0cb0 0x0770 0x07c0 0x06b0 0x06d0 0x0690 0x0690
	>;
	maxim,fg-params = /bits/ 16 <
		0xc1b0 0x083b 0x660e 0x4207 0x0081 0x5f00 0x07fc 0x07fc
		0x0c80 0x07fc 0xa55a 0x3600 0x1880 0x0a01 0x0784 0x05d0
		0x1c02 0x0280 0xf870 0x0400 0xc8ff 0xcea4
	>;
};
