// SPDX-License-Identifier: GPL-2.0-only
/dts-v1/;
/plugin/;

/*
 * Pixel 9a bring-up only; in no device's default DTB_OVERLAYS
 * (MODEM-PLAN G3, resolved; the palmtop's run kit applies it): the GNSS SPI's
 * pins. Replaced upstream by linux-omarchy-mobile#151, which describes the
 * same pins in zumapro-tegu.dts. Our SPI21 node has no pinctrl, so the bus runs on the
 * bootloader's pin state: gpp22-0..3 in function 2 at drive 0, gpp22-2
 * pulled down. This gives them function 2 and drive 3 (as gpp21, the
 * other SPI bus on PERIC1), keeping the pulls as found.
 */
&pinctrl_peric1 {
	gnss_spi_pins: gnss-spi-pins {
		samsung,pins = "gpp22-0", "gpp22-1", "gpp22-3";
		samsung,pin-function = <2>;
		samsung,pin-pud = <0>;
		samsung,pin-drv = <3>;
	};
	gnss_spi_miso: gnss-spi-miso-pins {
		samsung,pins = "gpp22-2";
		samsung,pin-function = <2>;
		samsung,pin-pud = <1>;
		samsung,pin-drv = <3>;
	};
};

&spi21 {
	pinctrl-names = "default";
	pinctrl-0 = <&gnss_spi_pins &gnss_spi_miso>;
};
